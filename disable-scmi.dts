/dts-v1/;
/plugin/;

/ {
	compatible = "radxa,zero-3w", "rockchip,rk3566";

	fragment@0 {
		target-path = "/firmware/scmi";
		__overlay__ {
			status = "disabled";
		};
	};

	fragment@1 {
		target-path = "/gpu@fde60000";
		__overlay__ {
			status = "disabled";
		};
	};
};
